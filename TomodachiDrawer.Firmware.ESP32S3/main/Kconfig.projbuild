## TomodachiDrawer.Firmware.ESP32S3/main/Kconfig.projbuild
```kconfig
menu "TomodachiDrawer Configuration"

    choice TDD_BOARD
        prompt "Target board"
        default TDD_BOARD_DEVKITC_1_R38
        help
            Pre-fills the LED GPIO for known boards. Pick "Custom" to set the
            GPIO manually below.

        config TDD_BOARD_DEVKITC_1_R38
            bool "ESP32-S3-DevKitC-1 (older rev, LED on GPIO 38)"

        config TDD_BOARD_DEVKITC_1_R48
            bool "ESP32-S3-DevKitC-1 (later rev, LED on GPIO 48)"

        config TDD_BOARD_S3_ZERO
            bool "Waveshare ESP32-S3-Zero (LED on GPIO 21)"

        config TDD_BOARD_DEVKITM_1
            bool "ESP32-S3-DevKitM-1 (LED on GPIO 48)"

        config TDD_BOARD_QTPY_S3
            bool "Adafruit QT Py ESP32-S3 (LED on GPIO 39)"

        config TDD_BOARD_LOLIN_S3_MINI
            bool "Lolin S3 Mini (LED on GPIO 47)"

        config TDD_BOARD_ATOM_S3
            bool "M5Stack AtomS3 / AtomS3 Lite (LED on GPIO 35)"

        config TDD_BOARD_CUSTOM
            bool "Custom - set TDD_LED_GPIO manually"
    endchoice

    config TDD_LED_GPIO
        int "Onboard WS2812 RGB LED GPIO"
        default 38 if TDD_BOARD_DEVKITC_1_R38
        default 48 if TDD_BOARD_DEVKITC_1_R48
        default 21 if TDD_BOARD_S3_ZERO
        default 48 if TDD_BOARD_DEVKITM_1
        default 39 if TDD_BOARD_QTPY_S3
        default 47 if TDD_BOARD_LOLIN_S3_MINI
        default 35 if TDD_BOARD_ATOM_S3
        default 38
        range 0 48

    config TDD_BOOT_BUTTON_GPIO
        int "Replay (BOOT) button GPIO"
        default 0
        range 0 48
        help
            Active-low. Default 0 = the BOOT button on every standard S3
            dev board.

endmenu
```

## TomodachiDrawer.Firmware.ESP32S3/sdkconfig.defaults
```kconfig
# Target chip
CONFIG_IDF_TARGET="esp32s3"

# Flash size on the DevKitC-1 is 4MB minimum (also fits 8MB / 16MB variants;
# the unused tail is simply left blank on bigger chips).
CONFIG_ESPTOOLPY_FLASHSIZE_4MB=y
CONFIG_ESPTOOLPY_FLASHSIZE="4MB"

# Use our custom partition table.
CONFIG_PARTITION_TABLE_CUSTOM=y
CONFIG_PARTITION_TABLE_CUSTOM_FILENAME="partitions.csv"

# Stdout (printf / ESP_LOGx) goes out UART0 on the CP2102 USB-UART bridge - that
# is the LEFT USB-C labeled "UART" on the DevKitC-1. This keeps the right "USB"
# port (native USB on GPIO 19/20) fully free for TinyUSB HID once we wire it up.
CONFIG_ESP_CONSOLE_UART_DEFAULT=y
CONFIG_ESP_CONSOLE_SECONDARY_NONE=y

# Run at 240MHz so report timing has plenty of headroom.
CONFIG_ESP_DEFAULT_CPU_FREQ_MHZ_240=y
CONFIG_ESP_DEFAULT_CPU_FREQ_MHZ=240

# TinyUSB: one HID interface (the Pokken-spoofed Switch gamepad). The native
# USB peripheral on the right USB-C port hosts this; CDC/MSC are off since we
# do not need them.
CONFIG_TINYUSB_HID_COUNT=1
CONFIG_TINYUSB_CDC_ENABLED=n
CONFIG_TINYUSB_MSC_ENABLED=n

# 1ms FreeRTOS tick. The HID polling interval is 8ms so we want to be able to
# push a fresh report at sub-tick-granularity during delays - the default
# 100Hz tick gives 10ms slices and would miss polls.
CONFIG_FREERTOS_HZ=1000
```
